## board/midas/kernel.its
```
/dts-v1/;

/ {
    description = "Galaxy S III / Galaxy Note 2 boot image";

    images {
        kernel {
            description = "kernel";
            data = /incbin/("./zImage");
            type = "kernel";
            arch = "arm";
            os = "linux";
            compression = "none";
            load = <0x40000000>;
            entry = <0x40000000>;
            hash-1 {
                algo = "md5";
            };
            hash-2 {
                algo = "sha1";
            };
        };

        exynos4412-i9300 {
            description = "exynos4412-i9300.dtb";
            data = /incbin/("./exynos4412-i9300.dtb");
            type = "flat_dt";
            arch = "arm";
            compression = "none";
            load = <0x60000000>;
            hash-1 {
                algo = "crc32";
            };
        };

        ramdisk {
            description = "buildroot ramdisk";
            data = /incbin/("./rootfs.cpio.lzma");
            type = "ramdisk";
            arch = "arm";
            os = "linux";
            compression = "lzma";
            hash-1 {
                algo = "crc32";
            };
        };
    };

    configurations {
        exynos4412-i9300 {
            description = "exynos4412-i9300";
            kernel = "kernel";
            fdt = "exynos4412-i9300";
            ramdisk = "ramdisk";
        };
   };
};
```
